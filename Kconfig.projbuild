## Kconfig.projbuild
```kconfig
menu "CYLOG Configuration"

    # orsource "$IDF_PATH/examples/common_components/env_caps/$IDF_TARGET/Kconfig.env_caps"
    choice CYLOG_LOG_LEN_TYPE
        prompt "日志长度类型"
        default CYLOG_LOG_LEN_IMMUTA

        config CYLOG_LOG_LEN_IMMUTA
            bool "固定长度"
        
        config CYLOG_LOG_LEN_MUTA
            bool "随内容长度-未测试"
                
    endchoice
    
    
    config CYLOG_EVENT_LEN
        int "事件-固定长度 (10-128)"
        depends on CYLOG_LOG_LEN_IMMUTA
        range 10 128
        default 64
        
    config CYLOG_RECORD_LEN
        int "记录-固定长度 (10-128)"
        depends on CYLOG_LOG_LEN_IMMUTA
        range 10 128
        default 64

endmenu
```
